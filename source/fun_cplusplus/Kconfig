## source/fun_cplusplus/Kconfig
```kconfig
###############################################################################
###############################################################################

mainmenu "test"

  menu "test1"
    # source ""
  endmenu

  menu "test2"
  endmenu

  menu "test3"
  endmenu

###############################################################################
```
